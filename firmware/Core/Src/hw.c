/*
 * SPDX-License-Identifier: MIT
 * Copyright (c) 2026 ATEK MIDAS
 */

#include "hw.h"
#include "ssd1306.h"
#include <string.h>

static const unsigned char font5x7[] = {
    0x00, 0x00, 0x00, 0x00, 0x00, 0x00, 0x00, 0x5f, 0x00, 0x00, 0x00, 0x07, 0x00, 0x07, 0x00,
    0x14, 0x7f, 0x14, 0x7f, 0x14, 0x24, 0x2a, 0x7f, 0x2a, 0x12, 0x23, 0x13, 0x08, 0x64, 0x62,
    0x36, 0x49, 0x55, 0x22, 0x50, 0x00, 0x05, 0x03, 0x00, 0x00, 0x00, 0x1c, 0x22, 0x41, 0x00,
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    0x00, 0x41, 0x36, 0x08, 0x00, 0x10, 0x08, 0x08, 0x10, 0x08, 0x00, 0x00, 0x00, 0x00, 0x00
};

// --- DRAWING ENGINE (ADAFRUIT GFX STYLE) ---
void Custom_DrawChar(int16_t x, int16_t y, unsigned char c, uint8_t size) {
    if((x >= 64) || (y >= 32) || ((x + 6 * size - 1) < 0) || ((y + 8 * size - 1) < 0))
        return; // Off-screen clipping (negative coordinate guard)

    if(c >= 128) c = 0;
    if(c >= 32) c -= 32; else c = 0;

    for (int8_t i=0; i<5; i++ ) {
        uint8_t line = font5x7[c * 5 + i];
        for (int8_t j = 0; j<8; j++) {
            if (line & 0x1) {
                if(size == 1) { // Size 1: thin text
                    if(x+i >= 0 && x+i < 64 && y+j >= 0 && y+j < 32)
                        ssd1306_DrawPixel(x+i, y+j, White);
                } else { // Size > 1: scaled block text
                    for(int dx=0; dx<size; dx++) {
                        for(int dy=0; dy<size; dy++) {
                            int16_t px = x + i*size + dx;
                            int16_t py = y + j*size + dy;
                            if(px >= 0 && px < 64 && py >= 0 && py < 32)
                                ssd1306_DrawPixel(px, py, White);
                        }
                    }
                }
            }
            line >>= 1;
        }
    }
}

void Custom_Print(int16_t x, int16_t y, const char* str, uint8_t size) {
    int16_t cursor_x = x;
    int16_t cursor_y = y;
    while(*str) {
        if(*str == '\n') {
            cursor_y += size * 8;
            cursor_x = x;
        } else {
            Custom_DrawChar(cursor_x, cursor_y, *str, size);
            cursor_x += size * 6;
        }
        str++;
    }
}


void HW_Init(void) {
	ssd1306_Init();
	ssd1306_WriteCommand(0xDA);
	ssd1306_WriteCommand(0x12);

	ssd1306_Fill(Black);
	ssd1306_UpdateScreen();
}

void HW_SetCtrlPins(const IOPin_t* pins, uint8_t val, uint8_t num_pins) {
    if (pins == NULL) return; // Safety check (e.g. DAC module has no control pins)

    for (int i = 0; i < num_pins; i++) {
        bool bit_val = (val >> i) & 0x01;
        HAL_GPIO_WritePin(pins[i].port, pins[i].pin, bit_val ? GPIO_PIN_SET : GPIO_PIN_RESET);
    }
}

void HW_SetDac(uint8_t val) {
    (void)val;
}

bool HW_GetButtonLeft(void) {
    return HAL_GPIO_ReadPin(PORT_BTN_LEFT, PIN_BTN_LEFT) == GPIO_PIN_SET;
}

bool HW_GetButtonRight(void) {
    return HAL_GPIO_ReadPin(PORT_BTN_RIGHT, PIN_BTN_RIGHT) == GPIO_PIN_SET;
}

uint32_t HW_GetTicks(void) {
    return HAL_GetTick();
}

// --- DISPLAY UPDATE (SAME LOGIC AS ESP32 VERSION) ---
void HW_UpdateDisplay(const char* top_text, const char* main_text, bool is_degree) {
    ssd1306_Fill(Black);

    bool has_top = (top_text != NULL && strlen(top_text) > 0);

    // 1. Top text and separator line (size 1)
    if (has_top) {
        Custom_Print(0, 0, top_text, 1);
        ssd1306_Line(0, 10, 64, 10, White);
    }

    // 2. Automatic font size selection
    uint8_t text_size = 2;

    int len = strlen(main_text);
    if (!has_top && len <= 3 && strchr(main_text, '\n') == NULL) {
        text_size = 3;
    } else {
        text_size = 2;
        int test_w = len * 6 * 2;
        int test_h = 8 * 2;
        int max_h = has_top ? 21 : 32;
        int total_w = test_w + (is_degree ? (2 * 3) : 0);

        if (total_w > 64 || test_h > max_h) {
            text_size = 1;
        }
    }

    // 3. Render text (ESP32 logic)
    const char* newline_ptr = strchr(main_text, '\n');

    if (newline_ptr != NULL) {
        char line1[16] = {0};
        char line2[16] = {0};
        strncpy(line1, main_text, newline_ptr - main_text);
        strcpy(line2, newline_ptr + 1);

        int w1 = strlen(line1) * 6 * text_size;
        int w2 = strlen(line2) * 6 * text_size;
        int line_spacing = text_size * 8;
        int total_h = line_spacing * 2;

        int y_start = has_top ? (11 + (21 - total_h) / 2 + 2) : ((32 - total_h) / 2);
        int x_pos1 = (64 - w1) / 2;
        int x_pos2 = (64 - w2) / 2;

        Custom_Print(x_pos1, y_start, line1, text_size);
        Custom_Print(x_pos2, y_start + line_spacing, line2, text_size);
    } else {
        int w = strlen(main_text) * 6 * text_size;
        int h = 8 * text_size;
        bool apply_bold = (text_size == 1);
        int total_w = w + (is_degree ? (text_size * 3) : 0) + (apply_bold ? 1 : 0);

        int x_pos = (64 - total_w) / 2;
        int y_pos = has_top ? (11 + (21 - h) / 2 + 2) : ((32 - h) / 2);

        Custom_Print(x_pos, y_pos, main_text, text_size);

        if (apply_bold) { // Bold effect for size 1
            Custom_Print(x_pos + 1, y_pos, main_text, text_size);
        }

        if (is_degree) {
            int circle_x = x_pos + w + (apply_bold ? 1 : 0) + text_size;
            int circle_y = y_pos + text_size;
            ssd1306_DrawCircle(circle_x, circle_y, text_size, White);
        }
    }

    ssd1306_UpdateScreen();
}

// --- BOOT ANIMATION (ORIGINAL GFX SLIDE EFFECT) ---
void HW_PlayBootAnimation(void) {
    int targetY_ATEK = 0;   // ATEK at Y=0 (pixels 0-15)
    int targetY_MIDAS = 16; // MIDAS at Y=16 (pixels 16-31, fits exactly)
    int currentY_ATEK = -20;
    int currentY_MIDAS = 35;
    int x_ATEK = 8;
    int x_MIDAS = 2;

    // Phase 1: slide in
    while (currentY_ATEK < targetY_ATEK || currentY_MIDAS > targetY_MIDAS) {
        ssd1306_Fill(Black);
        if (currentY_ATEK < targetY_ATEK) currentY_ATEK++;
        if (currentY_MIDAS > targetY_MIDAS) currentY_MIDAS--;
        Custom_Print(x_ATEK, currentY_ATEK, "ATEK", 2);
        Custom_Print(x_MIDAS, currentY_MIDAS, "MIDAS", 2);
        ssd1306_UpdateScreen();
        HAL_Delay(30);
    }

    HAL_Delay(1200);

    // Phase 2: slide out
    while (currentY_ATEK > -20 || currentY_MIDAS < 35) {
        ssd1306_Fill(Black);
        if (currentY_ATEK > -20) currentY_ATEK--;
        if (currentY_MIDAS < 35) currentY_MIDAS++;
        Custom_Print(x_ATEK, currentY_ATEK, "ATEK", 2);
        Custom_Print(x_MIDAS, currentY_MIDAS, "MIDAS", 2);
        ssd1306_UpdateScreen();
        HAL_Delay(30);
    }
    ssd1306_Fill(Black);
    ssd1306_UpdateScreen();
}
